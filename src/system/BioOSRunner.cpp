#include "zero_cpu/system/BioOSRunner.hpp"

#include "zero_cpu/assembler/Assembler.hpp"
#include "zero_cpu/binary/BinaryFormat.hpp"
#include "zero_cpu/binary/BinaryProgram.hpp"
#include "zero_cpu/binary/BinaryWriter.hpp"
#include "zero_cpu/core/CPU.hpp"
#include "zero_cpu/core/DebugOutputDevice.hpp"
#include "zero_cpu/core/InterruptController.hpp"
#include "zero_cpu/core/MMIOBus.hpp"
#include "zero_cpu/core/MemoryMap.hpp"
#include "zero_cpu/core/TimerDevice.hpp"
#include "zero_cpu/isa/InstructionEncoder.hpp"

#include <cstdint>
#include <fstream>
#include <memory>
#include <sstream>
#include <stdexcept>
#include <utility>
#include <vector>

namespace zero_cpu::system {
namespace {

std::string joinPath(const std::string& directory, const std::string& fileName) {
    if (directory.empty()) {
        return fileName;
    }

    const char last = directory.back();
    if (last == '\\' || last == '/') {
        return directory + fileName;
    }

    return directory + "\\" + fileName;
}

std::string readTextFile(const std::string& path) {
    std::ifstream file(path, std::ios::binary);
    if (!file) {
        throw std::runtime_error("Failed to open file: " + path);
    }

    std::ostringstream oss;
    oss << file.rdbuf();
    return oss.str();
}

void writeTextFile(const std::string& path, const std::string& text) {
    std::ofstream file(path, std::ios::binary);
    if (!file) {
        throw std::runtime_error("Failed to write file: " + path);
    }

    file << text;
}

std::string makeCombinedSource(const std::string& directory) {
    std::ostringstream source;

    source << "; Generated by Zero-CPU BioOSRunner\n";
    source << "; Source directory: " << directory << "\n\n";

    source << "; --- boot.zasm ---\n";
    source << readTextFile(joinPath(directory, "boot.zasm"));
    source << "\n\n";

    source << "; --- kernel.zasm ---\n";
    source << readTextFile(joinPath(directory, "kernel.zasm"));
    source << "\n\n";

    source << "; --- user_program.zasm ---\n";
    source << readTextFile(joinPath(directory, "user_program.zasm"));
    source << "\n";

    return source.str();
}

std::string combinedSourcePath(const BioOSRunOptions& options) {
    if (!options.combined_source_path.empty()) {
        return options.combined_source_path;
    }
    return joinPath(options.directory, "combined_boot.zasm");
}

std::string combinedBinaryPath(const BioOSRunOptions& options) {
    if (!options.combined_binary_path.empty()) {
        return options.combined_binary_path;
    }
    return joinPath(options.directory, "combined_boot.zbin");
}

std::size_t labelAddress(
    const AssembledProgram& assembled,
    const std::string& labelName,
    std::size_t codeBase
) {
    const auto it = assembled.labels.find(labelName);
    if (it == assembled.labels.end()) {
        throw std::runtime_error("BIO-OS label not found: " + labelName);
    }

    return codeBase + it->second * binary::kInstructionSize;
}

} // namespace

std::string bioOSDebugOutputAsAscii(const std::vector<std::int64_t>& writes) {
    std::string text;

    for (const std::int64_t value : writes) {
        if (value >= 32 && value <= 126) {
            text.push_back(static_cast<char>(value));
        } else if (value == 10) {
            text.push_back('\n');
        } else {
            text.push_back('.');
        }
    }

    return text;
}

BioOSRunResult BioOSRunner::run(const BioOSRunOptions& options) const {
    using namespace zero_cpu::binary;

    BioOSRunResult result;
    result.directory = options.directory;
    result.combined_source_path = combinedSourcePath(options);
    result.combined_binary_path = combinedBinaryPath(options);
    result.stack_base = memory_map::kBioOSStackBase;

    try {
        result.combined_source = makeCombinedSource(options.directory);

        if (options.write_generated_files) {
            writeTextFile(result.combined_source_path, result.combined_source);
        }

        Assembler assembler;
        AssembledProgram assembled = assembler.assembleString(result.combined_source);

        InstructionEncoder encoder;
        std::vector<std::uint8_t> code = encoder.encodeProgram(
            assembled.instructions,
            assembled.labels
        );

        result.instruction_count = assembled.instructions.size();
        result.code_size = code.size();

        BinaryProgram program;
        program.header.major_version = kMajorVersion;
        program.header.minor_version = kMinorVersion;
        program.header.endianness = BinaryEndianness::Little;
        program.header.entry_point = 0;
        program.header.code_size = static_cast<std::uint32_t>(code.size());
        program.code = std::move(code);

        if (options.write_generated_files) {
            BinaryWriter writer;
            writer.writeFile(result.combined_binary_path, program);
        }

        CPU cpu;
        auto interruptController = std::make_shared<InterruptController>();
        auto mmioBus = std::make_shared<MMIOBus>();
        auto debugOutputDevice = std::make_shared<DebugOutputDevice>();
        auto timerDevice = std::make_shared<TimerDevice>(interruptController, 44, 1000, 0);

        timerDevice->setEnabled(false);

        mmioBus->mapDevice(memory_map::kDebugOutputBase, memory_map::kDebugOutputSize, debugOutputDevice);
        mmioBus->mapDevice(memory_map::kTimerBase, memory_map::kTimerSize, timerDevice);

        cpu.loadBinaryProgram(program);
        cpu.setInterruptController(interruptController);
        cpu.setMMIOBus(mmioBus);
        cpu.clearClockedDevices();
        cpu.addClockedDevice(timerDevice);
        cpu.state().setSp(memory_map::kBioOSStackBase);

        result.syscall_handler_pc = labelAddress(assembled, "syscall_handler", cpu.binaryCodeBase());
        result.timer_handler_pc = labelAddress(assembled, "timer_handler", cpu.binaryCodeBase());

        interruptController->setVectorHandler(80, result.syscall_handler_pc);
        interruptController->setVectorHandler(44, result.timer_handler_pc);

        while (!cpu.state().halted() && result.step_count < options.max_steps) {
            cpu.step();

            if (cpu.state().hasError()) {
                result.has_error = true;
                result.error_message = cpu.state().errorMessage();
                break;
            }

            ++result.step_count;
        }

        if (!cpu.state().halted() && !result.has_error) {
            result.hit_step_limit = true;
            result.error_message = "BIO-OS step limit reached";
        }

        result.halted = cpu.state().halted();
        result.final_pc = cpu.state().pc();
        result.final_sp = cpu.state().sp();
        result.exit_code = cpu.state().registers().get(RegisterName::R7);

        result.debug_writes = debugOutputDevice->writes();
        result.debug_ascii = bioOSDebugOutputAsAscii(result.debug_writes);

        result.timer_tick_count = timerDevice->tickCount();
        result.timer_interval = timerDevice->interval();
        result.timer_vector = static_cast<int>(timerDevice->vector());
        result.timer_payload = timerDevice->payload();
        result.timer_interrupt_count = timerDevice->interruptCount();
        result.timer_enabled = timerDevice->enabled();

        return result;
    } catch (const std::exception& ex) {
        result.has_error = true;
        result.error_message = ex.what();
        return result;
    }
}

} // namespace zero_cpu::system